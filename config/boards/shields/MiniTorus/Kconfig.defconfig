## config/boards/shields/MiniTorus/Kconfig.defconfig
```kconfig
if SHIELD_MINITORUS_LEFT

config ZMK_KEYBOARD_NAME
    default "minitorus"

config ZMK_SPLIT_ROLE_CENTRAL
    default y

endif

if SHIELD_MINITORUS_LEFT || SHIELD_MINITORUS_RIGHT

config ZMK_SPLIT
    default y

endif
```

## config/boards/shields/MiniTorus/Kconfig.shield
```kconfig
# Copyright (c) 2020 The ZMK Contributors
# SPDX-License-Identifier: MIT

config SHIELD_MINITORUS_LEFT
    def_bool $(shields_list_contains,minitorus_left)

config SHIELD_MINITORUS_RIGHT
    def_bool $(shields_list_contains,minitorus_right)
```
