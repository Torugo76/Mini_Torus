## config/boards/shields/Torus/Kconfig.defconfig
```kconfig
# Copyright (c) 2020 The ZMK Contributors
# SPDX-License-Identifier: MIT


config ZMK_BLE
	default y

config ZMK_USB
	default y

if SHIELD_MINI_TORUS_LEFT

config ZMK_KEYBOARD_NAME
    default "Mini_Torus"

config ZMK_SPLIT_ROLE_CENTRAL
    default y

endif

if SHIELD_MINI_TORUS_LEFT || SHIELD_TORUS_RIGHT

config ZMK_SPLIT
    default y

endif
```

## config/boards/shields/Torus/Kconfig.shield
```kconfig
config SHIELD_MINI_TORUS_LEFT
    def_bool $(shields_list_contains,Mini_Torus_left)

config SHIELD_TORUS_RIGHT
    def_bool $(shields_list_contains,Mini_Torus_right)
```
